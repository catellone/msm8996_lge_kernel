## arch/arm64/configs/lineageos_us997_defconfig
```kconfig
include lineageos_lucye_common
# LG Platform
CONFIG_MACH_MSM8996_LUCYE_NAO_US=y

# Broadcom - Wifi
CONFIG_BCMDHD=y
CONFIG_BCMDHD_EXT=y
CONFIG_BCMDHD_PCIE=y
CONFIG_BCM4359=y
CONFIG_BCMDHD_COB=y
CONFIG_BCMDHD_USE_SCHED_SCAN=y
CONFIG_BCMDHD_HOSTAPD_BGN_MODE=y
CONFIG_BCMDHD_FOLLOW_AP_DTIM_PERIOD=n
CONFIG_WIFI_CONTROL_FUNC=y
CONFIG_BCMDHD_OEM_HEADER_PATH="soc/qcom/lge/wifi_bcm_lge.h"
CONFIG_BCMDHD_FW_PATH="/vendor/firmware/fw_bcmdhd.bin"
CONFIG_BCMDHD_NVRAM_PATH="/vendor/etc/wifi/bcmdhd.cal"
CONFIG_LGE_BCM433X_PATCH=y
CONFIG_BCMDHD_CONFIG_PATH="/data/misc/wifi/config"
CONFIG_BCMDHD_GPIO_WL_RESET=82
CONFIG_BCMDHD_USE_SCHED_SCAN=y
CONFIG_BROADCOM_WIFI_RESERVED_MEM=y
CONFIG_BCMDHD_PREALLOC_PKTIDMAP=y
CONFIG_BCMDHD_HOSTAPD_BGN_MODE=y
CONFIG_BCMDHD_CLM_PATH="/vendor/etc/wifi/4359_lg.clm_blob"
CONFIG_BCMDHD_FOLLOW_AP_DTIM_PERIOD=y

# LGE - PM
CONFIG_IDTP9223_CHARGER=y

# LGE - Sound
CONFIG_SND_USE_QUAT_MI2S=y

# Display
CONFIG_LGE_DISPLAY_AOD_SUPPORTED=y
CONFIG_LGE_DISPLAY_AOD_ON_CUSTOM=y

# ZRAM
CONFIG_ZRAM=y
CONFIG_ZSMALLOC=y
CONFIG_ZRAM_LZ4_COMPRESS=y
```
